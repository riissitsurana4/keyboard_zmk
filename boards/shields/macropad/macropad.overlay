/{
    chosen{zmk,kscan = &kscan0};

    kscan0: kscan{
        compatible = "zmk,kscan-gpio-matrix";

        diode-direction = "col-to-row";

        row-gpios = <
            &gpio0 24 (GPIO_PULL_DOWN | GPIO_ACTIVE_HIGH)
            &gpio0 22 (GPIO_PULL_DOWN | GPIO_ACTIVE_HIGH)
            &gpio0 20 (GPIO_PULL_DOWN | GPIO_ACTIVE_HIGH)
            &gpio0 17 (GPIO_PULL_DOWN | GPIO_ACTIVE_HIGH)
            &gpio0 11 (GPIO_PULL_DOWN | GPIO_ACTIVE_HIGH)
            >;
        
        col-gpios = <
            &gpio1 11 GPIO_ACTIVE_HIGH
            &gpio1 13 GPIO_ACTIVE_HIGH
            &gpio1 15 GPIO_ACTIVE_HIGH
        >;
    };
    encoder_1: encoder_1 {
         compatible = "alps,ec11";
        a-gpios = <&gpio1 2 GPIO_ACTIVE_HIGH>;
        b-gpios = <&gpio0 9 GPIO_ACTIVE_HIGH>;
        steps = <4>;
    };

     encoder_2: encoder_2 {
        compatible = "alps,ec11";
        a-gpios = <&gpio1 0 GPIO_ACTIVE_HIGH>;
        b-gpios = <&gpio0 10 GPIO_ACTIVE_HIGH>;
        steps = <4>;
    };
};